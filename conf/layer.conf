## conf/layer.conf
```bitbake
# We have a conf and classes directory, add to BBPATH
BBPATH .= ":${LAYERDIR}"

# We have a recipes directory containing .bb and .bbappend files, add to BBFILES
BBFILES += "${LAYERDIR}/recipes-*/*/*.bb \
            ${LAYERDIR}/recipes-*/*/*.bbappend"

BBFILE_COLLECTIONS += "bsp_bigtreetech_cb1"
BBFILE_PATTERN_bsp_bigtreetech_cb1 = "^${LAYERDIR}/"
BBFILE_PRIORITY_bsp_bigtreetech_cb1 = "11"
LAYERSERIES_COMPAT_bsp_bigtreetech_cb1 = "kirkstone"
LAYERDEPENDS_bsp_bigtreetech_cb1 = "meta-sunxi"
```

## conf/machine/bigtreetechCB1.conf
```bitbake
#@TYPE: Machine
#@NAME: Bigtreetech CB1
#@DESCRIPTION: Reference machine configuration for Bigtreetech CB1 boards
require conf/machine/include/sun50i.inc

#IMAGE_FSTYPES += "tar.bz2 jffs2 wic wic.bmap"
#EXTRA_IMAGECMD:jffs2 = "-lnp "
#WKS_FILE ?= "beaglebone-yocto.wks"
#IMAGE_INSTALL:append = " kernel-devicetree kernel-image-zimage"
#do_image_wic[depends] += "mtools-native:do_populate_sysroot dosfstools-native:do_populate_sysroot"

SERIAL_CONSOLES ?= "115200;ttyS0 115200;ttyO0"
SERIAL_CONSOLES_CHECK = "${SERIAL_CONSOLES}"

PREFERRED_PROVIDER_virtual/kernel ?= "linux-mainline"
PREFERED_VERSION_linux-mainline = "6.1.9"


#KERNEL_DEVICETREE = "allwinner/sun50i-h616-orangepi-zero2.dtb"
#UBOOT_MACHINE = "orangepi_zero2_defconfig"

#UBOOT_BINARY = "u-boot-nodtb.bin"
#SPL_BINARY = "u-boot-sunxi-with-spl.bin"

MACHINEOVERRIDES:append = "sun50i:sun50i-h616:"

# as for now neither graphics nor audio is supported
#MACHINE_FEATURES:remove = "alsa x11"
```
